## boards/shields/kc/Kconfig.defconfig
```kconfig
# Copyright (c) 2020 Ryan Cross
# SPDX-License-Identifier: MIT

if SHIELD_KC_LEFT

config ZMK_KEYBOARD_NAME
    default "Scylla"

config CONFIG_ZMK_SPLIT_ROLE_CENTRAL
    default y

config ZMK_SPLIT_BLE_ROLE_CENTRAL
    default y

endif

if SHIELD_KC_RIGHT

config ZMK_KEYBOARD_NAME
    default "Scylla Right"

endif

if SHIELD_KC_LEFT || SHIELD_KC_RIGHT

CONFIG_BT=y
CONFIG_BT_CTLR_TX_PWR_PLUS_8=y 
CONFIG_ZMK_SPLIT=y
CONFIG_ZMK_BLE=y
CONFIG_ZMK_SPLIT_BLE=y

config ZMK_SPLIT
    default y

endif
```

## boards/shields/kc/Kconfig.shield
```kconfig
config SHIELD_KC_LEFT
    def_bool $(shields_list_contains,kc_left)

config SHIELD_KC_RIGHT
    def_bool $(shields_list_contains,kc_right)
```

## boards/shields/kcustom/Kconfig.defconfig
```kconfig
# Copyright (c) 2020 Ryan Cross
# SPDX-License-Identifier: MIT

if SHIELD_KCustom_LEFT

config ZMK_KEYBOARD_NAME
    default "KCustom"

config ZMK_SPLIT_ROLE_CENTRAL
    default y


endif

if SHIELD_KCustom_RIGHT

config ZMK_KEYBOARD_NAME
    default "KCustom Right"

endif

if SHIELD_KCustom_LEFT || SHIELD_KCustom_RIGHT

config ZMK_SPLIT
    default y

endif
```

## boards/shields/kcustom/Kconfig.shield
```kconfig
config SHIELD_KCustom_LEFT
    def_bool $(shields_list_contains,kcustom_left)

config SHIELD_KCustom_RIGHT
    def_bool $(shields_list_contains,kcustom_right)
```
