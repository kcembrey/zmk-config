/*
 * Copyright (c) 2020 Ryan Cross
 *
 * SPDX-License-Identifier: MIT
 */

 #include "kcustom_seat.dtsi"

 &kscan0 {
	col-gpios
		= <&pro_micro_kc 4 (GPIO_ACTIVE_HIGH | GPIO_PULL_DOWN)>
		, <&pro_micro_kc 5 (GPIO_ACTIVE_HIGH | GPIO_PULL_DOWN)>
		, <&pro_micro_kc 6 (GPIO_ACTIVE_HIGH | GPIO_PULL_DOWN)>
		, <&pro_micro_kc 7 (GPIO_ACTIVE_HIGH | GPIO_PULL_DOWN)>
		, <&pro_micro_kc 8 (GPIO_ACTIVE_HIGH | GPIO_PULL_DOWN)>
		, <&pro_micro_kc 15 (GPIO_ACTIVE_HIGH | GPIO_PULL_DOWN)>
		;
		
	row-gpios
		= <&pro_micro_kc 10 GPIO_ACTIVE_HIGH>
		, <&pro_micro_kc 11 GPIO_ACTIVE_HIGH>
		, <&pro_micro_kc 12 GPIO_ACTIVE_HIGH>
		, <&pro_micro_kc 13 GPIO_ACTIVE_HIGH>
		, <&pro_micro_kc 14 GPIO_ACTIVE_HIGH>
		;
};