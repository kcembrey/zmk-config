## boards/shields/kcustom_seat/Kconfig.shield
```kconfig
config SHIELD_kcustom_seat_LEFT
    def_bool $(shields_list_contains,kcustom_seat_left)

config SHIELD_kcustom_seat_RIGHT
    def_bool $(shields_list_contains,kcustom_seat_right)
```

## boards/shields/seat/Kconfig.defconfig
```kconfig
# Copyright (c) 2020 Ryan Cross
# SPDX-License-Identifier: MIT

if SHIELD_KCustom_Seat_LEFT

config ZMK_KEYBOARD_NAME
    default "KCustom Seat"

config ZMK_SPLIT_ROLE_CENTRAL
    default y


endif

if SHIELD_KCustom_Seat_RIGHT

config ZMK_KEYBOARD_NAME
    default "KCustom Seat Right"

endif

if SHIELD_KCustom_Seat_LEFT || SHIELD_KCustom_Seat_RIGHT

config ZMK_SPLIT
    default y

endif
```

## boards/shields/seat/Kconfig.shield
```kconfig
config SHIELD_KCustom_Seat_LEFT
    def_bool $(shields_list_contains,KCustom_Seat_left)

config SHIELD_KCustom_Seat_RIGHT
    def_bool $(shields_list_contains,KCustom_Seat_right)
```

## config/boards/shields/kcustom_seat/Kconfig.defconfig
```kconfig
# Copyright (c) 2020 Ryan Cross
# SPDX-License-Identifier: MIT

if SHIELD_kcustom_seat_LEFT

config ZMK_KEYBOARD_NAME
    default "KCustom Seat"

config ZMK_SPLIT_ROLE_CENTRAL
    default y


endif

if SHIELD_kcustom_seat_RIGHT

config ZMK_KEYBOARD_NAME
    default "KCustom Seat Right"

endif

if SHIELD_kcustom_seat_LEFT || SHIELD_kcustom_seat_RIGHT

config ZMK_SPLIT
    default y

endif
```

## config/west.yml
```yaml
manifest:
  remotes:
    - name: zmkfirmware
      url-base: https://github.com/zmkfirmware
      # url-base: https://github.com/petejohanson
    - name: badjeff
      url-base: https://github.com/badjeff
  projects:
    - name: zmk
      remote: zmkfirmware
      # revision: feat/pointers-move-scroll
      revision: main
      import: app/west.yml
    - name: zmk-pmw3610-driver
      remote: badjeff
      revision: main
  self:
    path: config
```
